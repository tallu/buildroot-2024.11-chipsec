## .defconfig
```kconfig
BR2_x86_64=y
BR2_TOOLCHAIN_EXTERNAL=y
BR2_TARGET_GENERIC_ROOT_PASSWD="root"
BR2_ROOTFS_OVERLAY="${PWD}/extras/rootfs-overlay"
BR2_LINUX_KERNEL=y
BR2_LINUX_KERNEL_USE_ARCH_DEFAULT_CONFIG=y
BR2_LINUX_KERNEL_NEEDS_HOST_OPENSSL=y
BR2_LINUX_KERNEL_NEEDS_HOST_LIBELF=y
BR2_PACKAGE_PYTHON3_PYEXPAT=y
BR2_PACKAGE_NCURSES=y
BR2_PACKAGE_DROPBEAR=y
BR2_PACKAGE_CHIPSEC=y
BR2_TARGET_ROOTFS_INITRAMFS=y
# BR2_TARGET_ROOTFS_TAR is not set
BR2_PACKAGE_HOST_QEMU=y
BR2_PACKAGE_HOST_QEMU_SYSTEM_MODE=y
```

## package/chipsec/Config.in
```kconfig
config BR2_PACKAGE_CHIPSEC
	bool "chipsec"
	depends on !BR2_PACKAGE_PYTHON # python3
	depends on BR2_USE_WCHAR # python3
	depends on BR2_TOOLCHAIN_HAS_THREADS # python3
	depends on BR2_USE_MMU # python3
	depends on !BR2_STATIC_LIBS # python3
	depends on BR2_i386 || BR2_x86_64 # supported only on x86/x86_64
	depends on BR2_LINUX_KERNEL
	select BR2_PACKAGE_PYTHON3

	help
	  CHIPSEC is a framework for analyzing the security of PC
	  platforms including hardware, system firmware (BIOS/UEFI),
	  and platform components. 

	  https://github.com/chipsec/chipsec

comment "chipsec needs a toolchain w/ wchar, threads, dynamic library"
	depends on BR2_USE_MMU
	depends on BR2_i386 || BR2_x86_64
	depends on !BR2_USE_WCHAR || !BR2_TOOLCHAIN_HAS_THREADS || BR2_STATIC_LIBS

comment "chipsec needs a Linux kernel to be built"
	depends on BR2_USE_MMU
	depends on BR2_i386 || BR2_x86_64
	depends on !BR2_LINUX_KERNEL

comment "chipsec is not compatible with python"
	depends on BR2_USE_MMU
	depends on BR2_i386 || BR2_x86_64
	depends on BR2_PACKAGE_PYTHON

comment "chipsec depends on python3"
	depends on BR2_USE_MMU
	depends on BR2_i386 || BR2_x86_64
	depends on !BR2_PACKAGE_PYTHON3
```
